## drivers/connectivity/Kconfig
```kconfig
#
# Generic huawei hisi misc drivers configuration
#
menuconfig CONNECTIVITY_HI110X
	bool "Hisilicon Wireless Connectivity Support"
	---help---
		If you want to use Hisilicon  Wireless Connectivity, you should set this,
		and choose one product

if CONNECTIVITY_HI110X

config HI110X_DRIVER_PATH
	string "The Kernel Driver Path"
	default "drivers/connectivity/hisi"

source "drivers/connectivity/hisi/Kconfig"
source "drivers/connectivity/hisi/platform/Kconfig"
source "drivers/connectivity/hisi/wifi/Kconfig"
endif
```

## drivers/hisi/adc/Kconfig
```kconfig
config HISILICON_PLATFORM_ADC
	bool "HISILICON PLATFORM ADC"
	default n

if HISILICON_PLATFORM_ADC
config HI3XXX_HKADC
	bool "HISI ADC support"
	depends on HISI_MAILBOX
	default n
	help
	  Say yes here to support the HISI ADC device

config HI3XXX_HKADC_DEBUG
	tristate "HISI ADC DEBUG"
	help
	  Say yes here to support this lock
endif
```

## drivers/hisi/hi6402_vad/Kconfig
```kconfig
config HI6402_VAD
	tristate "Support for HI6402 VAD"
	default n
	---help---
	 Say Y here if you want to support HI6402 VAD
```

## drivers/hisi/load_image/Kconfig
```kconfig
config LOAD_IMAGE
	bool "Support HiSilicon load modem/dsp image"
	default n
	help
	  This driver supports HiSilicon LOAD IMAGE
	  
config MODEMID_HI3650
	bool "Support HiSilicon GET MODEM ID"
	default n
	help
	  This driver supports HiSilicon GET MODEM ID
	  
config MODEMID_HI6250
	bool "Support HiSilicon GET MODEM ID"
	default n
	help
	  This driver supports HiSilicon GET MODEM ID
	  	   
```

## drivers/hisi/perf_stat/Kconfig
```kconfig
config HISI_PERF_STAT
	bool "Hisilicon perf_stat driver"
	default n
	help
	Hi3650 perf_stat driver support
```

## drivers/hisi/perfhub/Kconfig
```kconfig
config HI3650_PERFHUB
       bool "hisi hi3650 perfhub"
       depends on ARCH_HI3650
       default y
```

## drivers/huawei_platform/power/Kconfig
```kconfig
source "drivers/huawei_platform/power/charger/Kconfig"
source "drivers/huawei_platform/power/coulometer/hisi_coul/Kconfig"
source "drivers/huawei_platform/power/battery/Kconfig"
source "drivers/huawei_platform/power/hw_kstate/Kconfig"
source "drivers/huawei_platform/power/ate/Kconfig"
source "drivers/huawei_platform/power/bastet/Kconfig"
source "drivers/huawei_platform/power/smpl/Kconfig"
source "drivers/huawei_platform/power/msgnotify/Kconfig"
source "drivers/huawei_platform/power/usb_short_circuit_protect/Kconfig"
```

## drivers/huawei_platform/power/coulometer/hisi_coul/Kconfig
```kconfig
config HISI_COULOMETER
        bool "hisi coulometer"
        default n
config HISI_COULOMETER_HI6421V500
        bool "hisi hi6421v500 coulometer"
        default n
config HISI_COULOMETER_TEST
        bool "hisi coulometer test"
        default n
```

## drivers/vcodec/imagination/VXD395/Kconfig
```kconfig
menuconfig IMAGINATION_VXD395_VCODEC
    tristate "Hi3xxx Support IMG Video Codec Drivers"
    default n
    ---help---
      This is the codec driver based on hi3xxx.

if IMAGINATION_VXD395_VCODEC      
source "drivers/vcodec/imagination/VXD395/imgvideo/Kconfig"
source "drivers/vcodec/imagination/VXD395/vdec/Kconfig"
source "drivers/vcodec/imagination/VXD395/encode/Kconfig"
endif
```

## drivers/vendor/hisi/modem/drv/acore/kernel/drivers/hisi/modem/drv/Kconfig
```kconfig
menu "Modem Drivers"

source "drivers/hisi/modem/drv/ipc/Kconfig"
source "drivers/hisi/modem/drv/icc/Kconfig"
source "drivers/hisi/modem/drv/balong_timer/Kconfig"
source "drivers/hisi/modem/drv/reset/Kconfig"
source "drivers/hisi/modem/drv/rfile/Kconfig"
source "drivers/hisi/modem/drv/nvim/Kconfig"
source "drivers/hisi/modem/drv/dsp/Kconfig"
source "drivers/hisi/modem/drv/s_memory/Kconfig"
source "drivers/hisi/modem/drv/hwadp/Kconfig"
source "drivers/hisi/modem/drv/onoff/Kconfig"
source "drivers/hisi/modem/drv/loadm/Kconfig"
source "drivers/hisi/modem/drv/udi/Kconfig"
source "drivers/hisi/modem/drv/sysctrl/Kconfig"
source "drivers/hisi/modem/drv/mem/Kconfig"
source "drivers/hisi/modem/drv/sync/Kconfig"
source "drivers/hisi/modem/drv/cshell/Kconfig"
source "drivers/hisi/modem/drv/misc/Kconfig"
source "drivers/hisi/modem/drv/ipf/Kconfig"
source "drivers/hisi/modem/drv/psam/Kconfig"
source "drivers/hisi/modem/drv/om/Kconfig"
source "drivers/hisi/modem/drv/pm_om/Kconfig"
source "drivers/hisi/modem/drv/temperature/Kconfig"
source "drivers/hisi/modem/drv/ocp/Kconfig"
endmenu
```
