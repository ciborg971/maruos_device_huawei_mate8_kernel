/**
 * Copyright (C) 2014 Hisilicon Ltd.
 *
 *  This program is free software; you can redistribute it and/or modify
 *  it under the terms of the GNU General Public License version 2 as
 *  publishhed by the Free Software Foundation.
 */

/dts-v1/;
/include/ "fastboot.dtsi"
/include/ "NEXT_CLG_VN1_config.dtsi"
/include/ "NEXT_CLG_VN2_pin.dtsi"
/include/ "NEXT_CLG_VN2_modem_pin.dtsi"
/include/ "NEXT_CLG_VN2_hi6402_pin.dtsi"

/ {
	hisi,boardid = <3 5 1 3>;
	hisi,boardname = "NEXT_CLG_VN2";
	hisi,modem_id = <0x3C002800>;
};
