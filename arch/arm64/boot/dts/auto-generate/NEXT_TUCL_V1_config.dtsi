/**
 * Copyright (C) 2014 Hisilicon Ltd.
 *
 *  This program is free software; you can redistribute it and/or modify
 *  it under the terms of the GNU General Public License version 2 as
 *  publishhed by the Free Software Foundation.
 */

/include/ "NEXT_TUCL_V0_config.dtsi"

/ {
	hisi,boardid = <3 5 0 1>;
	hisi,boardname = "NEXT_TUCL_V1";

};
