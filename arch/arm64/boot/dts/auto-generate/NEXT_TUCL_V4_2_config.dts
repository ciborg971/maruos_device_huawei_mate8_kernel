/**
 * Copyright (C) 2014 Hisilicon Ltd.
 *
 *  This program is free software; you can redistribute it and/or modify
 *  it under the terms of the GNU General Public License version 2 as
 *  publishhed by the Free Software Foundation.
 */

/dts-v1/;
/include/ "fastboot.dtsi"
/include/ "NEXT_TUCL_V4_config.dtsi"
/include/ "NEXT_TUCL_V4_2_pin.dtsi"
/include/ "NEXT_TUCL_V4_2_modem_pin.dtsi"
/include/ "NEXT_TUCL_V4_2_hi6402_pin.dtsi"

/ {
	hisi,boardid = <3 5 0 5>;
	hisi,boardname = "NEXT_TUCL_V4_2";
	hisi,modem_id = <0x3C001C00>;
};
