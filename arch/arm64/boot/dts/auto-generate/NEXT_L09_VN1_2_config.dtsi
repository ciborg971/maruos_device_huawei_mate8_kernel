/**
 * Copyright (C) 2014 Hisilicon Ltd.
 *
 *  This program is free software; you can redistribute it and/or modify
 *  it under the terms of the GNU General Public License version 2 as
 *  publishhed by the Free Software Foundation.
 */

/include/ "NEXT_L09_VN1_config.dtsi"

/ {
	hisi,boardid = <3 5 4 3>;
	hisi,boardname = "NEXT_L09_VN1_2";
	hisi,modem_id = <0x3C002400>;
};
